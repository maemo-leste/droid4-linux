## Documentation/devicetree/bindings/mfd/motorola-mdm.txt
```
Motorola MDM modem device tree binding

Required properties:
- compatible		: Must be one of "motorola,mapphone-mdm6600-serdev"
			  or a generic "motorola,mdm6600"
- phys			: USB PHY with shared pins for UART power management
- phy-names		: Name for the USB PHY
- reg			: SPI chip select

Example:

&uart1 {
	modem {
		compatible = "motorola,mapphone-mdm6600-serdev";
		phys = <&fsusb1_phy>;
		phy-names = "usb";
	};
};
```

## Documentation/devicetree/bindings/phy/motorola,mapphone-mdm6600.yaml
```yaml
# SPDX-License-Identifier: GPL-2.0-only OR BSD-2-Clause
%YAML 1.2
---
$id: http://devicetree.org/schemas/phy/motorola,mapphone-mdm6600.yaml#
$schema: http://devicetree.org/meta-schemas/core.yaml#

title: Motorola Mapphone MDM6600 and MDM9600 USB PHY

maintainers:
  - Tony Lindgren <tony@atomide.com>

description: |
  USB PHY found on Motorola Mapphone devices integrated in the MDM6600 and
  MDM9600 modems.

properties:
  compatible:
    enum:
      - motorola,mapphone-mdm6600
      - motorola,mapphone-mdm9600

  clocks:
    maxItems: 1

  clock-names:
    maxItems: 1
    description: MDM9600 USB PHY clock

  "#phy-cells":
    const: 0

  enable-gpios:
    maxItems: 1
    description: Enable gpio

  power-gpios:
    maxItems: 1
    description: Power gpio

  reset-gpios:
    maxItems: 1
    description: Reset gpio

  motorola,mode-gpios:
   minItems: 2
   maxItems: 2
   description: Modem mode gpios

  motorola,cmd-gpios:
   minItems: 3
   maxItems: 3
   description: Modem command gpios

  motorola,status-gpios:
   minItems: 3
   maxItems: 3
   description: Modem status gpios

required:
  - compatible
  - "#phy-cells"
  - enable-gpios
  - power-gpios
  - reset-gpios
  - motorola,mode-gpios
  - motorola,cmd-gpios
  - motorola,status-gpios

allOf:
  - if:
      properties:
        compatible:
          contains:
            enum:
              - motorola,mapphone-mdm9600
    then:
      properties:
        motorola,cmd-gpios:
          maxItems: 2
        clocks:
          minItems: 1
          maxItems: 1
        clock-names:
          items:
            - const: main_clk

additionalProperties: false

examples:
  - |
    #include <dt-bindings/gpio/gpio.h>

    usb-phy {
        compatible = "motorola,mapphone-mdm6600";
        #phy-cells = <0>;
        enable-gpios = <&gpio3 31 GPIO_ACTIVE_LOW>;
        power-gpios = <&gpio2 22 GPIO_ACTIVE_HIGH>;
        reset-gpios = <&gpio2 17 GPIO_ACTIVE_HIGH>;
        motorola,mode-gpios = <&gpio5 20 GPIO_ACTIVE_HIGH>,
                              <&gpio5 21 GPIO_ACTIVE_HIGH>;
        motorola,cmd-gpios = <&gpio4 7 GPIO_ACTIVE_HIGH>,
                             <&gpio4 8 GPIO_ACTIVE_HIGH>,
                             <&gpio5 14 GPIO_ACTIVE_HIGH>;
        motorola,status-gpios = <&gpio2 20 GPIO_ACTIVE_HIGH>,
                                <&gpio2 21 GPIO_ACTIVE_HIGH>,
                                <&gpio2 23 GPIO_ACTIVE_HIGH>;
    };
```

## Documentation/devicetree/bindings/serdev/serdev-ngsm.yaml
```yaml
# SPDX-License-Identifier: GPL-2.0-only OR BSD-2-Clause
%YAML 1.2
---
$id: http://devicetree.org/schemas/serdev/serdev-ngsm.yaml#
$schema: http://devicetree.org/meta-schemas/core.yaml#

title: Generic serdev-ngsm TS 27.010 driver

maintainers:
  - Tony Lindgren <tony@atomide.com>

properties:
  compatible:
    enum:
      - etsi,3gpp-ts27010-adaption1
      - motorola,mapphone-mdm6600-serial

  ttymask:
    $ref: /schemas/types.yaml#/definitions/uint64
    description: Mask of the TS 27.010 channel TTY interfaces to start (64 bit)

  "#address-cells":
    const: 1

  "#size-cells":
    const: 0

allOf:
  - if:
      properties:
        compatible:
          contains:
            const: motorola,mapphone-mdm6600-serial
    then:
      properties:
        phys:
          $ref: /schemas/types.yaml#/definitions/phandle-array
          description: USB PHY needed for shared GPIO PM wake-up pins
          maxItems: 1

        phy-names:
          description: Name of the USB PHY
          const: usb

        compatible:
          description: GNSS receiver
          const: motorola,mapphone-mdm6600-gnss

      required:
        - phys
        - phy-names

required:
  - compatible
  - ttymask
  - "#address-cells"
  - "#size-cells"

examples:
  - |
    modem {
      compatible = "motorola,mapphone-mdm6600-serial";
      ttymask = <0 0x00001fee>;
      phys = <&fsusb1_phy>;
      phy-names = "usb";
      #address-cells = <1>;
      #size-cells = <0>;

      gnss@4 {
         compatible = "motorola,mapphone-mdm6600-gnss";
         reg = <4>;
      };
    };
```

## drivers/tty/serdev/Kconfig
```kconfig
# SPDX-License-Identifier: GPL-2.0
#
# Serial bus device driver configuration
#
menuconfig SERIAL_DEV_BUS
	tristate "Serial device bus"
	help
	  Core support for devices connected via a serial port.

	  Note that you typically also want to enable TTY port controller support.

if SERIAL_DEV_BUS

config SERIAL_DEV_CTRL_TTYPORT
	bool "Serial device TTY port controller"
	help
	  Say Y here if you want to use the Serial device bus with common TTY
	  drivers (e.g. serial drivers).

	  If unsure, say Y.
	depends on TTY
	depends on SERIAL_DEV_BUS != m
	default y

config SERIAL_DEV_N_GSM
	tristate "Serial device TS 27.010 support"
	depends on N_GSM
	depends on SERIAL_DEV_CTRL_TTYPORT
	help
	  Select this if you want to use the TS 27.010 with a serial port with
	  devices such as modems and GNSS devices.

	  If unsure, say N.

endif
```
